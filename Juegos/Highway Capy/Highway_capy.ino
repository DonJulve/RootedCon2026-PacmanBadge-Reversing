#include <TFT_eSPI.h>

TFT_eSPI tft = TFT_eSPI();

// --- CONFIGURACIÓN DE PINES ---
const int PIN_LEFT   = 15;  
const int PIN_RIGHT  = 27;  
const int PIN_ACCEL  = 25;  
const int PIN_BRAKE  = 26;  
const int PIN_START  = 13;  
const int PIN_SELECT = 33;  
const int PIN_TFT_BL = 21;  

// --- COLORES ---
#define COLOR_ROAD   tft.color565(80, 80, 80)
#define COLOR_GRASS  tft.color565(34, 139, 34)
#define COLOR_TRANS  0x0000 // Negro transparente

// --- SPRITES (16x16) ---
const uint16_t capybara_sprite[256] PROGMEM = { 
  0x0000, 0x0000, 0x0000, 0x0000, 0x0000, 0x0001, 0x0001, 0x0000, 0x0000, 0x0000, 0x0000, 0x0000, 0x0000, 0x0000, 0x0000, 0x0000,
  0x0000, 0x0000, 0x0001, 0xA34A, 0xA34A, 0xA34A, 0xA34A, 0x0001, 0x0001, 0x0000, 0x0000, 0x0000, 0x0000, 0x0000, 0x0000, 0x0000,
  0x0000, 0x0001, 0xA34A, 0xA34A, 0xA34A, 0xA34A, 0xA34A, 0xA34A, 0xA34A, 0x0001, 0x0000, 0x0000, 0x0000, 0x0000, 0x0000, 0x0000,
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  0x0000, 0x0000, 0x0000, 0x0000, 0x0000, 0x0000, 0x0000, 0x0000, 0x0000, 0x0000, 0x0000, 0x0000, 0x0000, 0x0000, 0x0000, 0x0000
};

const uint16_t sprite_car[256] PROGMEM = { 
  0x0000,0x0000,0x0000,0x0000,0x0001,0x0001,0x0001,0x0001,0x0001,0x0001,0x0001,0x0001,0x0000,0x0000,0x0000,0x0000,
  0x0000,0x0000,0x0000,0x0001,0x001F,0x001F,0x001F,0x001F,0x001F,0x001F,0x001F,0x001F,0x0001,0x0000,0x0000,0x0000,
  0x0000,0x0001,0x0001,0x001F,0x001F,0x001F,0x001F,0x001F,0x001F,0x001F,0x001F,0x001F,0x001F,0x0001,0x0001,0x0000,
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  0x0000,0x0000,0x0000,0x0000,0x0000,0x0000,0x0000,0x0000,0x0000,0x0000,0x0000,0x0000,0x0000,0x0000,0x0000,0x0000
};

struct Enemy {
  int x;
  float y;
  float speed;
};

// --- VARIABLES ---
int capyX = 56, oldCapyX = 56;
const int capyY = 130;
#define NUM_ENEMIES 3
Enemy enemies[NUM_ENEMIES];
float oldEnemyY[NUM_ENEMIES];

int gear = 1;
float gameSpeed = 2.0;
float lineOffset = 0;
unsigned long score = 0;
int gameState = 0; 
bool isScreenOn = true;
unsigned long lastButtonTime = 0, lastGearTime = 0;

void setup() {
  pinMode(PIN_LEFT, INPUT_PULLUP);
  pinMode(PIN_RIGHT, INPUT_PULLUP);
  pinMode(PIN_ACCEL, INPUT_PULLUP);
  pinMode(PIN_BRAKE, INPUT_PULLUP);
  pinMode(PIN_START, INPUT_PULLUP);
  pinMode(PIN_SELECT, INPUT_PULLUP);
  pinMode(PIN_TFT_BL, OUTPUT);
  digitalWrite(PIN_TFT_BL, HIGH);

  tft.init();
  tft.setRotation(2); 
  tft.setSwapBytes(true); 
  showMenu();
}

void showMenu() {
  tft.fillScreen(COLOR_ROAD);
  tft.fillRect(0, 0, 16, 160, COLOR_GRASS);
  tft.fillRect(112, 0, 16, 160, COLOR_GRASS);
  tft.pushImage(56, 40, 16, 16, capybara_sprite, COLOR_TRANS);
  tft.setTextColor(TFT_WHITE, COLOR_ROAD);
  tft.drawCentreString("HIGHWAY CAPY", 64, 20, 2);
  tft.setTextColor(TFT_YELLOW, COLOR_ROAD);
  tft.drawCentreString("PULSA START", 64, 100, 1);
  gameState = 0;
}

void spawnEnemy(int i, int startY) {
  enemies[i].x = random(18, 94);
  enemies[i].y = startY;
  enemies[i].speed = random(5, 15) / 10.0;
}

void resetGame() {
  capyX = 56; oldCapyX = 56;
  score = 0; gear = 1; gameSpeed = 2.0;
  for(int i=0; i<NUM_ENEMIES; i++) {
    spawnEnemy(i, -30 - (i * 60));
    oldEnemyY[i] = enemies[i].y;
  }
  tft.fillScreen(COLOR_ROAD);
  tft.fillRect(0, 0, 16, 160, COLOR_GRASS);
  tft.fillRect(112, 0, 16, 160, COLOR_GRASS);
  gameState = 1;
}

void eraseAndDraw() {
  // 1. Borrar rastro anterior del Capibara con rectángulos de carretera
  if (capyX != oldCapyX) {
    tft.fillRect(oldCapyX, capyY, 16, 16, COLOR_ROAD);
  }

  // 2. Borrar rastro de enemigos
  for (int i = 0; i < NUM_ENEMIES; i++) {
    if ((int)enemies[i].y != (int)oldEnemyY[i]) {
      // Borramos la caja entera del enemigo en su posición vieja
      tft.fillRect(enemies[i].x, (int)oldEnemyY[i], 16, 16, COLOR_ROAD);
    }
  }

  // 3. Dibujar líneas de la carretera (solo si se mueven)
  static int lastLineY[4];
  for(int i=0; i<4; i++) {
     int y = ((int)lineOffset + i*40) % 160;
     tft.fillRect(62, (y + 140) % 160, 4, 20, COLOR_ROAD); // Borrar
     tft.fillRect(62, y, 4, 20, TFT_WHITE); // Dibujar
  }

  // 4. Dibujar Sprites en nuevas posiciones
  for (int i = 0; i < NUM_ENEMIES; i++) {
    if (enemies[i].y > -16 && enemies[i].y < 160) {
      tft.pushImage(enemies[i].x, (int)enemies[i].y, 16, 16, sprite_car, COLOR_TRANS);
    }
  }
  tft.pushImage(capyX, capyY, 16, 16, capybara_sprite, COLOR_TRANS);

  // 5. UI Superior (Score y Gear)
  tft.fillRect(0, 0, 128, 12, COLOR_GRASS);
  tft.setTextColor(TFT_WHITE);
  tft.drawNumber(score, 2, 2);
  tft.drawRightString("G:" + String(gear), 126, 2, 1);
}

void updateLogic() {
  unsigned long now = millis();
  
  if (digitalRead(PIN_ACCEL) == LOW && now - lastGearTime > 250) {
    if (gear < 3) gear++;
    lastGearTime = now;
  }
  if (digitalRead(PIN_BRAKE) == LOW && now - lastGearTime > 250) {
    if (gear > 1) gear--;
    lastGearTime = now;
  }

  gameSpeed = (gear == 1) ? 1.5 : (gear == 2 ? 3.5 : 6.0);
  score += gear;
  lineOffset += gameSpeed;
  if (lineOffset >= 160) lineOffset = 0;

  for(int i=0; i<NUM_ENEMIES; i++) {
    oldEnemyY[i] = enemies[i].y;
    enemies[i].y += (enemies[i].speed + gameSpeed);
    
    if (enemies[i].y > 160) spawnEnemy(i, -20);

    // Colisión
    if (abs(capyX - enemies[i].x) < 12 && abs(capyY - (int)enemies[i].y) < 12) {
      gameState = 2;
    }
  }
}

void loop() {
  unsigned long currentMillis = millis();

  if (digitalRead(PIN_SELECT) == LOW && currentMillis - lastButtonTime > 300) {
    isScreenOn = !isScreenOn;
    digitalWrite(PIN_TFT_BL, isScreenOn ? HIGH : LOW);
    lastButtonTime = currentMillis;
  }

  if (gameState == 0) {
    if (digitalRead(PIN_START) == LOW) resetGame();
  } 
  else if (gameState == 1) {
    oldCapyX = capyX;
    if (digitalRead(PIN_LEFT) == LOW) capyX -= 3;
    if (digitalRead(PIN_RIGHT) == LOW) capyX += 3;
    capyX = constrain(capyX, 16, 96);

    updateLogic();
    eraseAndDraw();
    
    if (gameState == 2) {
      tft.fillRect(20, 60, 88, 40, TFT_BLACK);
      tft.drawRect(20, 60, 88, 40, TFT_WHITE);
      tft.setTextColor(TFT_RED);
      tft.drawCentreString("CRASH!", 64, 65, 2);
      tft.setTextColor(TFT_WHITE);
      tft.drawCentreString("Score: " + String(score), 64, 85, 1);
    }
    delay(20); // FPS constante
  } 
  else if (gameState == 2) {
    if (digitalRead(PIN_START) == LOW && currentMillis - lastButtonTime > 500) {
      showMenu();
      lastButtonTime = currentMillis;
    }
  }
}
